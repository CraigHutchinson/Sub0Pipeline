## CMakeLists.txt
```
cmake_minimum_required(VERSION 3.21)
find_package(Zephyr REQUIRED HINTS $ENV{ZEPHYR_BASE})
project(Sub0PipelineZephyr LANGUAGES C CXX)
# Compile only the portable core. Requires a full C++23 standard library,
# including stop_token/mutex/thread; the minimal Zephyr C++ library is insufficient.
target_sources(app PRIVATE src/main.cpp ../../src/sub0pipeline.cpp)
target_include_directories(app PRIVATE ../../include)
target_compile_definitions(app PRIVATE SUB0PIPELINE_EXCEPTIONS=0)
```

## prj.conf
```kconfig
CONFIG_CPP=y
CONFIG_STD_CPP2B=y
CONFIG_REQUIRES_FULL_LIBCPP=y
CONFIG_MAIN_STACK_SIZE=32768
CONFIG_HEAP_MEM_POOL_SIZE=65536
CONFIG_THREAD_STACK_INFO=y
```

## src/main.cpp
```c
#include <atomic>
#include <zephyr/sys/printk.h>

#include "zephyr_executor.hpp"

using namespace sub0pipeline;
static int exercise()
{
    ZephyrExecutor<2> executor;
    Pipeline pipe;
    std::atomic<int> calls{0};
    auto root = pipe.emplace([] {});
    auto ack = pipe.emplace([&] { ++calls; });
    for (int i = 0; i < 16; ++i)
    {
        auto task = pipe.emplace([&] { ++calls; });
        task.succeed(root).precede(ack);
    }
    if (!pipe.run(executor) || calls != 17) return 1;
    // Stop-aware device wait: registration wakes the Zephyr semaphore from
    // task context. The request comes from another job, without wall-clock sleep.
    Pipeline cancelled;
    std::stop_source stop;
    k_sem ready;
    k_sem_init(&ready, 0, 1);
    auto read = cancelled.emplace([&](std::stop_token token) -> std::expected<void, PipelineError> {
        std::stop_callback wake{token, [&] { k_sem_give(&ready); }};
        stop.request_stop();
        k_sem_take(&ready, K_FOREVER);
        return std::unexpected(PipelineError::kCancelled);
    });
    bool acknowledged = false;
    (void)cancelled.emplace([&] { acknowledged = true; }).succeed(read);
    auto result = cancelled.run(executor, stop.get_token());
    cancelled.joinOrphans();
    if (result || result.error() != PipelineError::kCancelled || acknowledged) return 2;
    Pipeline io;
    k_sem entered;
    k_sem_init(&entered, 0, 1);
    auto event = io.addOnDemand([&](std::stop_token token) -> std::expected<void, PipelineError> {
        std::stop_callback wake{token, [&] { k_sem_give(&ready); }};
        k_sem_give(&entered);
        k_sem_take(&ready, K_FOREVER);
        return std::unexpected(PipelineError::kCancelled);
    });
    io.arm(executor);
    if (!io.trigger(event)) return 3;
    k_sem_take(&entered, K_FOREVER);
    event.cancel();
    executor.waitAll();
    io.joinOrphans();
    if (io.status(event) != JobStatus::kCancelled) return 4;
    return 0;
}

int main()
{
    if (const int error = exercise())
    {
        printk("Sub0Pipeline Zephyr bounded: FAIL %d\n", error);
        return error;
    }
    // Report only after executor destruction has joined the worker.
    printk("Sub0Pipeline Zephyr bounded: PASS\n");
    return 0;
}
```

## src/zephyr_executor.hpp
```c
#pragma once
#include <array>
#include <zephyr/kernel.h>

#include "sub0pipeline/sub0pipeline.hpp"

// Fixed queue and one Zephyr worker. Saturation runs on the caller; therefore
// jobs must be thread-affinity independent and tolerate inline recursion.
// Task context only, serialized shutdown after producers stop. Callables and
// Pipeline state can still allocate; fixed queue storage is not heap-free run.
template<std::size_t Capacity = 8>
class ZephyrExecutor final : public sub0pipeline::IExecutor
{
    static_assert(Capacity > 0);
public:
    ZephyrExecutor()
    {
        k_mutex_init(&mutex_);
        k_condvar_init(&ready_);
        k_msgq_init(&queue_, queueBuffer_.data(), sizeof(Task*), Capacity);
        k_thread_create(&thread_, stack_, K_KERNEL_STACK_SIZEOF(stack_),
                        entry, this, nullptr, nullptr, 5, 0, K_NO_WAIT);
    }
    ~ZephyrExecutor() override
    {
        waitAll();
        Task* stop = nullptr;
        k_msgq_put(&queue_, &stop, K_FOREVER);
        k_thread_join(&thread_, K_FOREVER);
    }
    void dispatch(std::string_view, std::function<void()> fn,
                  std::function<void()> complete, int, uint8_t, uint32_t) override
    {
        k_mutex_lock(&mutex_, K_FOREVER);
        ++pending_;
        Task* slot = nullptr;
        for (auto& task : tasks_) if (!task.used) { slot = &task; task.used = true; break; }
        if (slot) { slot->fn = std::move(fn); slot->complete = std::move(complete); }
        k_mutex_unlock(&mutex_);
        if (slot)
        {
            // Each queued/running task owns a slot, so the queue cannot be full.
            if (k_msgq_put(&queue_, &slot, K_NO_WAIT) != 0) std::terminate();
        }
        else
        {
            fn();
            if (complete) complete();
            complete = {}; fn = {};
            finish(nullptr);
        }
    }
    void waitAll() override
    {
        k_mutex_lock(&mutex_, K_FOREVER);
        while (pending_ != 0) k_condvar_wait(&ready_, &mutex_, K_FOREVER);
        k_mutex_unlock(&mutex_);
    }
    int concurrency() const noexcept override { return 1; }
private:
    struct Task { std::function<void()> fn, complete; bool used = false; };
    static void entry(void* self, void*, void*) { static_cast<ZephyrExecutor*>(self)->loop(); }
    void loop()
    {
        for (;;)
        {
            Task* task;
            k_msgq_get(&queue_, &task, K_FOREVER);
            if (!task) return;
            task->fn();
            if (task->complete) task->complete();
            task->complete = {}; task->fn = {};
            finish(task);
        }
    }
    void finish(Task* task)
    {
        k_mutex_lock(&mutex_, K_FOREVER);
        if (task) task->used = false;
        --pending_;
        k_condvar_broadcast(&ready_);
        k_mutex_unlock(&mutex_);
    }
    std::array<Task, Capacity> tasks_{};
    alignas(Task*) std::array<char, Capacity * sizeof(Task*)> queueBuffer_{};
    k_msgq queue_{};
    k_mutex mutex_{};
    k_condvar ready_{};
    std::size_t pending_ = 0;
    k_thread thread_{};
    K_KERNEL_STACK_MEMBER(stack_, 16384);
};
```
